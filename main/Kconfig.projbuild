## main/Kconfig.projbuild
```kconfig
menu "ESP32 Uart Bridge Configuration"

    orsource "$IDF_PATH/examples/common_components/env_caps/$IDF_TARGET/Kconfig.env_caps"

    config UBRIDGE_UART_PORT_NUM
        int "UART port number"
        range 0 2 if IDF_TARGET_ESP32 || IDF_TARGET_ESP32S3
        default 0 if IDF_TARGET_ESP32 || IDF_TARGET_ESP32S3
        range 0 1 if IDF_TARGET_ESP32S2 || IDF_TARGET_ESP32C3 || IDF_TARGET_ESP32C2 || IDF_TARGET_ESP32H2
        default 0 if IDF_TARGET_ESP32S2 || IDF_TARGET_ESP32C3 || IDF_TARGET_ESP32C2 || IDF_TARGET_ESP32H2
        help
            UART communication port number.
            See UART documentation for available port numbers.

    config UBRIDGE_UART_BAUD_RATE
        int "UART communication speed"
        range 1200 115200
        default 115200
        help
            UART communication speed.

    config UBRIDGE_UART_RXD
        int "UART RXD pin number"
        range ENV_GPIO_RANGE_MIN 25
        default 20
        help
            GPIO number for UART RX pin. See UART documentation for more information
            about available pin numbers for UART.

    config UBRIDGE_UART_TXD
        int "UART TXD pin number"
        range ENV_GPIO_RANGE_MIN 25
        default 21
        help
            GPIO number for UART TX pin. See UART documentation for more information
            about available pin numbers for UART.

endmenu
```
